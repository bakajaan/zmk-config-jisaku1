## config/west.yml
```yaml
manifest:
  defaults:
    revision: main
  remotes:
    - name: cormoran
      url-base: https://github.com/cormoran
    - name: caksoylar
      url-base: https://github.com/caksoylar
    - name: bakajaan
      url-base: https://github.com/bakajaan
  # =====================================================================
  # 【SHAピン留め 2026-07-26】外部依存は動作確認済みのコミットに固定。
  # 上流ブランチの更新でビルドや挙動が勝手に変わるのを防ぐ。
  # 更新したいときは revision を新しいSHA（または一時的にブランチ名）に差し替える。
  # zmk-keymap-common は自分のリポジトリ（キーマップ編集を即反映させたい）のため main 追従のまま。
  # =====================================================================
  projects:
    # ZMK: cormoran fork, main+dya = ZMK main (Zephyr 4.1) + DYA Studio RPC
    # (main+dya の 2026-07-25 時点 HEAD)
    - name: zmk
      remote: cormoran
      revision: e5c9b6915b56801193e359dd9bad4a167ce0d1b8
      import: app/west.yml
    # RGB LED widget (main supports Zephyr 4.1 / xiao_ble naming)
    - name: zmk-rgbled-widget
      remote: caksoylar
      revision: e6b467792a1dabef8cfa5c9fd26bfefc9c16662b
    # DYA Studio modules (main = Zephyr4対応)
    - name: zmk-module-ble-management
      remote: cormoran
      revision: 57738cc4fc6ba80e82a7ac57741a0339cb186cd4
    - name: zmk-module-battery-history
      remote: cormoran
      revision: 307755dd2ad4d320e14de162e8e5ef018f29d929
    - name: zmk-module-settings-rpc
      remote: cormoran
      revision: 78f86df9e6c5edaf57bef3ccbd7f360cfdf49291
    # DYA Studio トラブルシューティング機能
    - name: zmk-feature-device-info
      remote: cormoran
      revision: 8cedd2dd9f04e19ea5a17b94914dd47a09d8db11
    - name: zmk-feature-watchdog
      remote: cormoran
      revision: 84ad14c6c3645dc40b23f45d08ab45418655f912
      import: true
    - name: zmk-feature-kscan-diagnostics
      remote: cormoran
      revision: 1432f7fe0cfe903cd7d3c9931ae6bd6f2e1f328e
      import: true
    # BLEコントローラのアサート記録 (2026-07-27追加)
    # LL_ASSERT失敗を素のk_oops（PC/LRだけでシンボル解決不能）ではなく、
    # 発生元のソースファイル名と行番号としてウォッチドッグ記録に残す。
    - name: zmk-feature-ctlr-assert
      remote: bakajaan
      revision: 59d09925dc64bc3aaf30accfbbdf42ea922c0948
    # ランタイムマクロ / ランタイムコンボ (DYA Studio Macro & Comboタブ用 2026-07-26追加)
    # 上流READMEでは「動作確認中」の位置付けのため、実機で要動作確認
    - name: zmk-feature-runtime-macro
      remote: cormoran
      revision: 38530962eb7061b60efcb98e84585cfb1f0cb6de
      import: true
    - name: zmk-feature-runtime-combo
      remote: cormoran
      revision: d9490e7b5d41c516221d131241009e81740efcee
      import: true
    # 上記2モジュールの共通依存。module側manifest (west-dependency.yml) はmain追従のため
    # ここで明示的に定義してSHA固定で上書きする (top-level manifestが優先される)
    - name: zmk-feature-custom-settings
      remote: cormoran
      revision: c6a7fef3a3be3d3ace5de9a4b0628c6418cd1f3f
    # 入力ストリーム (DYA Studioの打鍵ヒートマップ/Streamトグル用 2026-07-26追加)
    - name: zmk-feature-input-stream
      remote: cormoran
      revision: aeb015908a42a7615ccdccc7feb3a10d23132a71
    # 打鍵統計 (キーボード側に保存するヒートマップ + キーコード別集計 2026-07-27追加)
    # Studioを開いていない間の打鍵も記録され、再起動しても保持される。
    - name: zmk-feature-key-usage
      remote: bakajaan
      revision: 02c9fea60535524796f5fe0f1ebdfeed5fbf8b96
    # OS検出 + 接続先ごとのデフォルトレイヤー切替 (DYA Studio接続タブ用 2026-07-26追加)
    # os-detection は custom-settings に依存するが、上でSHA固定済みのため import は使わない
    - name: zmk-feature-os-detection
      remote: cormoran
      revision: 3052679f645b8fc1997275c2eaa6b86bdd55ca01
    - name: zmk-feature-default-layer
      remote: cormoran
      revision: 92728246f80d327709839b2dbf5cf11880ff87e1
    # 共通キーマップ定義(jisaku_1 / aerogu34で共有・main追従)
    - name: zmk-keymap-common
      remote: bakajaan
  self:
    path: config
```
