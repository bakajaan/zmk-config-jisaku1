## boards/shields/jisaku_1/Kconfig.defconfig
```kconfig
if SHIELD_JISAKU_1_LEFT

config ZMK_KEYBOARD_NAME
    default "jisaku_1"

config ZMK_SPLIT_ROLE_CENTRAL
    default y

endif

if SHIELD_JISAKU_1_LEFT || SHIELD_JISAKU_1_RIGHT

config ZMK_SPLIT
    default y

endif
```

## boards/shields/jisaku_1/Kconfig.shield
```kconfig
config SHIELD_JISAKU_1_LEFT
    def_bool $(shields_list_contains,jisaku_1_left)

config SHIELD_JISAKU_1_RIGHT
    def_bool $(shields_list_contains,jisaku_1_right)
```
